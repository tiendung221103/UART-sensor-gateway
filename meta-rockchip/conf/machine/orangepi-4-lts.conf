## meta-rockchip/conf/machine/orangepi-4-lts.conf
```bitbake
#@TYPE: Machine
#@NAME: Orange Pi 4 LTS
#@DESCRIPTION: Machine configuration for Orange Pi 4 LTS (RK3399, non-eMMC)

require conf/machine/include/rk3399.inc

KERNEL_DEVICETREE = "rockchip/rk3399-orangepi-4-lts.dtb"
MACHINE_EXTRA_RRECOMMENDS += "kernel-modules"

# UBOOT_MACHINE = "orangepi-rk3399_defconfig"
EXTRA_IMAGEDEPENDS += "virtual/bootloader"
PREFERRED_PROVIDER_virtual/kernel = "linux-orangepi"
PREFERRED_VERSION_linux-orangepi = "6.6"

KBUILD_DEFCONFIG = "defconfig"
ROCKCHIP_KERNEL_IMAGES = ""

KERNEL_IMAGETYPE = "Image"
KERNEL_IMAGETYPES = "Image"

PREFERRED_PROVIDER_virtual/bootloader = "u-boot-orangepi"
PREFERRED_VERSION_u-boot-orangepi = "2024.10"
PREFERRED_PROVIDER_linux-libc-headers = "linux-libc-headers"
PREFERRED_VERSION_linux-libc-headers = "6.6%"
```

## meta-rockchip/wic/orangepi-4-lts.wks
```
# GPT chiếm sector 0~33, idbloader ở 32KiB, u-boot.itb ở 8MiB
bootloader --ptable gpt
part --source rawcopy --sourceparams="file=idbloader.img" --ondisk mmcblk --no-table --offset 32K
part --source rawcopy --sourceparams="file=u-boot.itb" --ondisk mmcblk --no-table --offset 8M

part /boot --source bootimg-partition --fstype=ext4 --label boot --part-name boot --offset 16M --fixed-size 128M --ondisk mmcblk --no-fstab-update

part / --source rootfs --fstype=ext4 --label root --part-name rootfs --uuid 0c18644f-826b-40e9-8b9a-ad7f65af00a5 --ondisk mmcblk --no-fstab-update
```
